## board/friendlyelec/nanopc-t6-rk3588/Kconfig
```kconfig
if TARGET_NANOPCT6_RK3588

config SYS_BOARD
	default "nanopc-t6-rk3588"

config SYS_VENDOR
	default "friendlyelec"

config SYS_CONFIG_NAME
	default "nanopc-t6-rk3588"

config NANOPC_T6_SHOW_LOGO
	bool "Show the NanoPC-T6 boot logo"
	default y

endif
```
